## components/prg32_audio/Kconfig
```kconfig
menu "PRG32 Audio"

config PRG32_AUDIO_ENABLED
    bool "Enable PRG32 I2S audio runtime"
    default y
    help
        Enable the PRG32 digital audio runtime. The runtime is safe when no
        speaker is attached; sound is produced only after student code calls
        prg32_audio_init().

config PRG32_AUDIO_SAMPLE_RATE
    int "Audio sample rate"
    depends on PRG32_AUDIO_ENABLED
    default 22050
    range 8000 44100
    help
        Mixer and I2S output sample rate. 22050 Hz is the classroom default.

choice PRG32_AUDIO_MODE
    prompt "Default audio mode"
    depends on PRG32_AUDIO_ENABLED
    default PRG32_AUDIO_MODE_MONO

config PRG32_AUDIO_MODE_MONO
    bool "Mono audio"
    help
        Default PRG32 audio mode. Use one MAX98357A I2S DAC/amplifier.

config PRG32_AUDIO_MODE_STEREO
    bool "Stereo audio (PRG32 Audio Plus)"
    help
        Optional PRG32 Audio Plus mode. Use two MAX98357A boards on the same
        I2S bus, with one board selecting left and the other selecting right.

endchoice

config PRG32_AUDIO_MAX_VOICES
    int "Maximum mixer voices"
    depends on PRG32_AUDIO_ENABLED
    default 6
    range 1 8
    help
        Number of simultaneous sample/synth voices. Mono defaults to 6.

config PRG32_AUDIO_I2S_BCLK_GPIO
    int "I2S BCLK GPIO"
    depends on PRG32_AUDIO_ENABLED
    default 4

config PRG32_AUDIO_I2S_LRCLK_GPIO
    int "I2S LRCLK/WS GPIO"
    depends on PRG32_AUDIO_ENABLED
    default 11

config PRG32_AUDIO_I2S_DATA_GPIO
    int "I2S DATA/DIN GPIO"
    depends on PRG32_AUDIO_ENABLED
    default 23

config PRG32_AUDIO_I2S_SD_GPIO
    int "I2S SD/shutdown GPIO"
    depends on PRG32_AUDIO_ENABLED
    default -1
    help
        Optional amplifier shutdown/control GPIO. Set to -1 when not wired.

endmenu
```

## sdkconfig.defaults.esp32c6_128k
```kconfig
# ESP32-C6 large-cartridge profile. Combine this after sdkconfig.defaults.
# Rebuild both the resident firmware and every cartridge after selecting it.
CONFIG_PRG32_CART_RAM_LARGE_128=y
CONFIG_PRG32_CART_MAX_KIB=128
```

## sdkconfig.defaults.metrics
```kconfig
# Optional profiling/lab profile. Use together with sdkconfig.defaults:
# idf.py -D SDKCONFIG_DEFAULTS="sdkconfig.defaults;sdkconfig.defaults.metrics" build
CONFIG_PRG32_METRICS_ENABLE=y
CONFIG_PRG32_METRICS_SERVER_URL="http://192.168.4.2:8080"
CONFIG_PRG32_METRICS_BOARD_ID="prg32-board"
CONFIG_PRG32_METRICS_SAMPLE_PERIOD_FRAMES=1
CONFIG_PRG32_METRICS_UPLOAD_PERIOD_MS=5000
CONFIG_PRG32_METRICS_QUEUE_LEN=512
```

## sdkconfig.defaults.p4
```kconfig
# ESP32-P4 using the same classroom 320x240 SPI ILI9341 harness as ESP32-C6.
CONFIG_PARTITION_TABLE_CUSTOM=y
CONFIG_PARTITION_TABLE_CUSTOM_FILENAME="partitions_prg32.csv"
CONFIG_ESPTOOLPY_FLASHSIZE_16MB=y
CONFIG_ESPTOOLPY_FLASHSIZE="16MB"
CONFIG_ESP_CONSOLE_USB_SERIAL_JTAG=y
CONFIG_PRG32_DISPLAY_ILI9341=y
CONFIG_PRG32_CART_RAM_P4=y
CONFIG_PRG32_AUDIO_ENABLED=y
CONFIG_PRG32_AUDIO_SAMPLE_RATE=22050
CONFIG_PRG32_AUDIO_MODE_MONO=y
CONFIG_PRG32_AUDIO_MAX_VOICES=6
CONFIG_PRG32_SPLASH_ENABLED=y
CONFIG_PRG32_SPLASH_DURATION_MS=1000
CONFIG_PRG32_SPLASH_SOUND_ENABLED=y
```
