## profiles/sdkconfig.defaults
```kconfig
CONFIG_PARTITION_TABLE_CUSTOM=y
CONFIG_PARTITION_TABLE_CUSTOM_FILENAME="profiles/partitions_prg32.csv"
CONFIG_ESPTOOLPY_FLASHSIZE_4MB=y
CONFIG_ESPTOOLPY_FLASHSIZE="4MB"
CONFIG_ESP_CONSOLE_UART_DEFAULT=y
# CONFIG_ESP_CONSOLE_USB_SERIAL_JTAG is not set
CONFIG_ESP_CONSOLE_SECONDARY_USB_SERIAL_JTAG=y
# CONFIG_ESP_CONSOLE_SECONDARY_NONE is not set
CONFIG_PRG32_DISPLAY_ILI9341=y
CONFIG_PRG32_CART_RAM_EXTENDED=y
CONFIG_PRG32_CART_MAX_KIB=64
CONFIG_PRG32_AUDIO_ENABLED=y
CONFIG_PRG32_AUDIO_SAMPLE_RATE=22050
CONFIG_PRG32_AUDIO_MODE_MONO=y
CONFIG_PRG32_AUDIO_MAX_VOICES=8
CONFIG_PRG32_SPLASH_ENABLED=y
CONFIG_PRG32_SPLASH_DURATION_MS=1000
CONFIG_PRG32_SPLASH_SOUND_ENABLED=y
CONFIG_ESP_SYSTEM_MEMPROT_FEATURE=n
CONFIG_ESP_SYSTEM_PMP_IDRAM_SPLIT=n
CONFIG_PRG32_WIFI_BOOT_MODE_AP=y
CONFIG_PRG32_WIFI_SSID="PRG32"
CONFIG_PRG32_WIFI_PASSWORD="prg32game"
CONFIG_PRG32_STORE_URL="https://store.prg32.uniparthenope.it/"
CONFIG_PRG32_CART_RAM_KIB=64
CONFIG_PRG32_CART_MAX_KIB=64
# CONFIG_PRG32_CART_RAM_CLASSROOM is not set
CONFIG_PRG32_CART_RAM_EXTENDED=y
```

## sdkconfig.defaults
```kconfig
CONFIG_PARTITION_TABLE_CUSTOM=y
CONFIG_PARTITION_TABLE_CUSTOM_FILENAME="partitions_prg32.csv"
CONFIG_ESPTOOLPY_FLASHSIZE_4MB=y
CONFIG_ESPTOOLPY_FLASHSIZE="4MB"
CONFIG_ESP_CONSOLE_UART_DEFAULT=y
# CONFIG_ESP_CONSOLE_USB_SERIAL_JTAG is not set
CONFIG_ESP_CONSOLE_SECONDARY_USB_SERIAL_JTAG=y
# CONFIG_ESP_CONSOLE_SECONDARY_NONE is not set
CONFIG_PRG32_DISPLAY_ILI9341=y
CONFIG_PRG32_CART_RAM_EXTENDED=y
CONFIG_PRG32_CART_MAX_KIB=64
CONFIG_PRG32_AUDIO_ENABLED=y
CONFIG_PRG32_AUDIO_SAMPLE_RATE=22050
CONFIG_PRG32_AUDIO_MODE_MONO=y
CONFIG_PRG32_AUDIO_MAX_VOICES=8
CONFIG_PRG32_AUDIO_I2S_BCLK_GPIO=4
CONFIG_PRG32_AUDIO_I2S_LRCLK_GPIO=11
CONFIG_PRG32_AUDIO_I2S_DATA_GPIO=23
CONFIG_PRG32_AUDIO_I2S_SD_GPIO=-1
CONFIG_PRG32_SPLASH_ENABLED=y
CONFIG_PRG32_SPLASH_DURATION_MS=1000
CONFIG_PRG32_SPLASH_SOUND_ENABLED=y
CONFIG_ESP_SYSTEM_MEMPROT_FEATURE=n
CONFIG_ESP_SYSTEM_PMP_IDRAM_SPLIT=n
# Bluetooth LE keyboard host (docs/hardware/bluetooth_keyboard.md).
# The ESP32-C6 radio is Bluetooth LE only; NimBLE is the smaller host stack.
CONFIG_BT_ENABLED=y
CONFIG_BT_NIMBLE_ENABLED=y
CONFIG_BT_NIMBLE_ROLE_CENTRAL=y
CONFIG_BT_NIMBLE_ROLE_OBSERVER=y
CONFIG_BT_NIMBLE_ROLE_PERIPHERAL=n
CONFIG_BT_NIMBLE_ROLE_BROADCASTER=n
CONFIG_BT_NIMBLE_MAX_CONNECTIONS=1
CONFIG_BT_NIMBLE_MAX_BONDS=3
CONFIG_BT_NIMBLE_NVS_PERSIST=y
CONFIG_BT_NIMBLE_SECURITY_ENABLE=y
CONFIG_BT_NIMBLE_50_FEATURE_SUPPORT=n
CONFIG_BT_NIMBLE_LOG_LEVEL_WARNING=y
CONFIG_PRG32_BT_KEYBOARD=y
```
