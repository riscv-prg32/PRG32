## components/prg32/Kconfig
```kconfig
menu "PRG32 Framework"

choice PRG32_DISPLAY_BACKEND
    prompt "Display backend"
    default PRG32_DISPLAY_ILI9341
    help
        Select the display implementation used by the PRG32 graphics ABI.
        The ILI9341 backend is for the physical ESP32-C6 classroom board. The
        QEMU RGB backend is for desktop screen testing with Espressif's
        ESP32-C3 RISC-V QEMU target and idf.py qemu --graphics.

config PRG32_DISPLAY_ILI9341
    bool "ILI9341 SPI TFT"
    help
        Use the reference ILI9341 320x240 SPI TFT display connected to the
        ESP32-C6 pins configured in main/prg32_config.h.

config PRG32_DISPLAY_QEMU_RGB
    bool "QEMU virtual RGB panel"
    depends on IDF_TARGET_ESP32C3
    help
        Use Espressif QEMU's virtual RGB framebuffer. Run with:
        idf.py qemu --graphics monitor

endchoice

config PRG32_QEMU_FAIL_ON_REAL_HW
    bool "Fail fast when QEMU backend is run on real hardware"
    depends on PRG32_DISPLAY_QEMU_RGB
    default y
    help
        The QEMU RGB backend is not available on physical ESP32 boards.
        Keep this enabled so accidental real-hardware flashes stop clearly
        during display initialization instead of silently losing graphics.

config PRG32_QEMU_UART_INPUT
    bool "Enable QEMU keyboard input through the UART console"
    depends on PRG32_DISPLAY_QEMU_RGB && ESP_CONSOLE_UART
    default y
    help
        Read simple keyboard controls from the QEMU UART console and translate
        them into the normal PRG32 player 1 input bits. This is for desktop
        classroom testing only; physical ESP32-C6 builds still use GPIO buttons.

config PRG32_SPLASH_ENABLED
    bool "Show PRG32 startup splash"
    default y
    help
        Draw the PRG32 splash screen when the resident firmware starts.

config PRG32_SPLASH_DURATION_MS
    int "Startup splash duration in milliseconds"
    depends on PRG32_SPLASH_ENABLED
    default 900
    range 0 5000
    help
        How long the firmware startup splash remains visible before runtime
        initialization continues.

config PRG32_SPLASH_SOUND_ENABLED
    bool "Play welcome sound during startup splash"
    depends on PRG32_SPLASH_ENABLED
    default y
    help
        When the PRG32 I2S audio subsystem is enabled, initialize it and play a
        short welcome tone sequence while the firmware splash is visible.

choice PRG32_CART_RAM_PROFILE
    prompt "Executable cartridge RAM profile"
    default PRG32_CART_RAM_LARGE_128
    help
        Choose how much internal executable RAM the resident firmware reserves
        for uploadable cartridges. The window always starts at the same
        address, so changing its size does not move prg32_cart_exec. Portable
        cartridges that fit the selected window run without being rebuilt. The
        128 KiB profile requires the low-memory ILI9341 renderer.

config PRG32_CART_RAM_CLASSROOM
    bool "Classroom profile, 32 KiB"
    help
        Reserve a smaller cartridge window for normal labs and examples. This
        leaves more SRAM available to the resident runtime, Wi-Fi, setup menus,
        diagnostics, and framebuffer work.

config PRG32_CART_RAM_EXTENDED
    bool "Extended profile, 64 KiB"
    help
        Reserve a 64 KiB cartridge execution window. It leaves 64 KiB more
        free heap than the default 128 KiB profile for firmware that does not
        need cartridges larger than 64 KiB.

config PRG32_CART_RAM_LARGE_128
    bool "Large profile, 128 KiB"
    help
        Reserve a 128 KiB executable cartridge window. This is the default for
        ESP32-C6 and QEMU builds. It costs 64 KiB of free heap compared with
        the 64 KiB profile. Stored cartridges are read through a flash mapping,
        so loading one needs no heap copy of its payload. Portable cartridges
        built for the 32 KiB or 64 KiB profile run without being rebuilt.

config PRG32_CART_RAM_CUSTOM
    bool "Custom profile"
    help
        Select a custom cartridge RAM window. Keep the value small for
        classroom firmware unless a lab explicitly needs more executable RAM.

endchoice

config PRG32_CART_RAM_CUSTOM_KIB
    int "Custom executable cartridge RAM window in KiB"
    depends on PRG32_CART_RAM_CUSTOM
    default 48
    range 16 128
    help
        Custom size for the statically placed cartridge execution window.
        Rebuild both the resident firmware and cartridges after changing it.

config PRG32_CART_RAM_KIB
    int
    default 32 if PRG32_CART_RAM_CLASSROOM
    default 64 if PRG32_CART_RAM_EXTENDED
    default 128 if PRG32_CART_RAM_LARGE_128
    default PRG32_CART_RAM_CUSTOM_KIB if PRG32_CART_RAM_CUSTOM
    default 32

config PRG32_CART_MAX_KIB
    int "Maximum stored cartridge image size in KiB"
    default 128 if PRG32_CART_RAM_LARGE_128
    default 64
    range 32 128
    help
        Maximum accepted .prg32 image size. Keep this at or below the size of
        every cartridge partition. The default 128 KiB RAM profile uses a
        matching 128 KiB image limit.

menu "Performance metrics"

config PRG32_METRICS_ENABLE
    bool "Enable buffered performance metrics upload"
    default n
    help
        Collect frame timing, heap, and input samples in a small ring buffer and
        upload batches to the PRG32 metrics server. Leave this disabled for
        normal classroom gameplay unless a lab explicitly measures performance.

config PRG32_METRICS_SERVER_URL
    string "Metrics server URL"
    depends on PRG32_METRICS_ENABLE
    default "http://192.168.4.2:8080"
    help
        Base URL for the standalone PRG32 MetricsServer Flask app.

config PRG32_METRICS_BOARD_ID
    string "Metrics board identifier"
    depends on PRG32_METRICS_ENABLE
    default "prg32-board"
    help
        Human-readable board identifier stored with each metrics run.

config PRG32_METRICS_SAMPLE_PERIOD_FRAMES
    int "Metrics sample period in frames"
    depends on PRG32_METRICS_ENABLE
    default 1
    range 1 3600
    help
        Record one sample every N frames. Use higher values when measuring long
        runs on slow or unreliable networks.

config PRG32_METRICS_UPLOAD_PERIOD_MS
    int "Metrics upload period in milliseconds"
    depends on PRG32_METRICS_ENABLE
    default 5000
    range 250 60000
    help
        Background upload task period. Recording never waits for this upload.

config PRG32_METRICS_QUEUE_LEN
    int "Metrics upload queue length"
    depends on PRG32_METRICS_ENABLE
    default 128
    range 8 1024
    help
        Number of samples allocated when a metrics run starts. If the queue
        fills, PRG32 drops new samples and reports the drop count with the next
        batch. Keep this modest for normal gameplay; recording remains
        non-blocking and never allocates from the frame path.

endmenu

menu "CartridgeStore integration"

config PRG32_STORE_URL
    string "CartridgeStore base URL"
    default ""
    help
        Base URL of the CartridgeStore instance used for catalog browsing
        and cartridge download. Leave empty to use mDNS auto-discovery.
        Example: http://192.168.1.42:5080
        In QEMU builds, mDNS is unavailable; set this to reach a LAN server.

menu "Wi-Fi Configuration"

choice PRG32_WIFI_BOOT_MODE
    prompt "Wi-Fi Boot Mode"
    default PRG32_WIFI_BOOT_MODE_AP
    help
        Select the initial Wi-Fi mode at boot.
        Access Point (AP) mode hosts its own network.
        Infrastructure (STA) mode connects to an existing network.

config PRG32_WIFI_BOOT_MODE_AP
    bool "Access Point (AP)"
    help
        The board creates its own network (e.g. SSID "PRG32").

config PRG32_WIFI_BOOT_MODE_STA
    bool "Infrastructure (STA)"
    help
        The board connects to an existing local network.

endchoice

config PRG32_WIFI_SSID
    string "Wi-Fi SSID"
    default "PRG32"
    help
        The SSID of the network. If in AP mode, this is the network name
        broadcasted by the device. If in STA mode, this is the network
        to connect to.

config PRG32_WIFI_PASSWORD
    string "Wi-Fi Password"
    default "prg32game"
    help
        The password of the network. Must be at least 8 characters for WPA2.

endmenu

menu "PRG32 Board Configuration"

choice PRG32_PIN_PROFILE_CHOICE
    prompt "Hardware Pin Profile"
    default PRG32_PIN_PROFILE_NONE
    help
        Select the hardware pin configuration profile.
        "None": pins are unconfigured and the build will halt unless a profile is specified.
        "breadboard1": reference breadboard pin profile loaded from profiles/sdkconfig.pins.breadboard1.
        "pcb1": soldered PCB pin profile loaded from profiles/sdkconfig.pins.pcb1.
        "Custom": configure GPIO pins manually below in menuconfig.

config PRG32_PIN_PROFILE_NONE
    bool "None (no default - build halts)"
    help
        No pin profile selected. The build will halt with an error explaining
        that a pin profile must be chosen either via menuconfig or by passing
        --pin-profile <name> to the build command.

config PRG32_PIN_PROFILE_BREADBOARD1
    bool "breadboard1 (First Breadboard)"
    help
        Reference breadboard pin configuration profile loaded from
        profiles/sdkconfig.pins.breadboard1. Pin numbers are defined in the
        profile file and will override the menuconfig defaults during build.

config PRG32_PIN_PROFILE_BREADBOARD2
    bool "breadboard2 (Second Breadboard with Analog Joystick)"
    help
        Second breadboard pin configuration profile loaded from
        profiles/sdkconfig.pins.breadboard2. Features an analog joystick
        sampled via ADC one-shot mode, updated display pin assignments,
        buttons C and D, and the L and R bumpers.

config PRG32_PIN_PROFILE_PCB1
    bool "pcb1 (Soldered PCB, DOWN on GPIO13)"
    help
        Pin configuration profile loaded from profiles/sdkconfig.pins.pcb1.
        It is the profile for the first version of the Maypad.

config PRG32_PIN_PROFILE_CUSTOM
    bool "Custom Profile (configure pins manually in menuconfig)"
    help
        Specify custom GPIO pins directly in menuconfig below.

endchoice

config PRG32_PIN_PROFILE_CUSTOM_NAME
    string "Custom Pin Profile Name"
    depends on PRG32_PIN_PROFILE_CUSTOM
    default "custom"
    help
        Name identifier for your custom pin configuration profile.

config PRG32_DEFAULT_PIN_PROFILE
    string "Hardware Pin Profile Name"
    default "" if PRG32_PIN_PROFILE_NONE
    default "breadboard1" if PRG32_PIN_PROFILE_BREADBOARD1
    default "breadboard2" if PRG32_PIN_PROFILE_BREADBOARD2
    default "pcb1" if PRG32_PIN_PROFILE_PCB1
    default PRG32_PIN_PROFILE_CUSTOM_NAME if PRG32_PIN_PROFILE_CUSTOM
    default ""
    help
        Name identifier of the hardware pin profile.

config PRG32_PIN_PROFILE_NAME
    string
    default PRG32_DEFAULT_PIN_PROFILE

config PRG32_PINS_CONFIGURED
    bool "PRG32 Pin Profile Configured"
    default y if PRG32_PIN_PROFILE_CUSTOM
    default n
    help
        Indicates that a hardware pin profile has been selected and loaded.
        Hardware builds without this option set will be rejected at build time.

config PRG32_PIN_LCD_MOSI
    int "LCD MOSI GPIO"
    default -1

config PRG32_PIN_LCD_MISO
    int "LCD MISO GPIO"
    default -1

config PRG32_PIN_LCD_SCLK
    int "LCD SCLK GPIO"
    default -1

config PRG32_PIN_LCD_CS
    int "LCD CS GPIO"
    default -1

config PRG32_PIN_LCD_DC
    int "LCD DC GPIO"
    default -1

config PRG32_PIN_LCD_RST
    int "LCD RST GPIO"
    default -1
    help
        GPIO that drives the ILI9341 hardware reset. Use -1 when no GPIO
        drives RST, for example when it is wired to the ESP32-C6 EN (RST)
        pin or to 3V3. The driver then relies on the ILI9341 software reset
        command sent at the start of display initialization.

config PRG32_PIN_LCD_BL
    int "LCD Backlight GPIO"
    default -1

choice PRG32_JOYSTICK_TYPE
    prompt "Joystick Type"
    default PRG32_JOYSTICK_DIGITAL
    help
        Select joystick hardware type:
        - Digital: 4 directional switch inputs (UP, DOWN, LEFT, RIGHT).
        - Analog: 2-axis potentiometer thumbstick read via ADC one-shot mode.

config PRG32_JOYSTICK_DIGITAL
    bool "Digital Joystick (discrete GPIO switches)"
    help
        Reads direction states from discrete active-low GPIO switches.

config PRG32_JOYSTICK_ANALOG
    bool "Analog Joystick (ADC one-shot mode on X/Y axes)"
    help
        Converts the analog potentiometer voltage on two ADC1 channels each time
        input is read into calibrated -127..127 axes and derives direction
        states from them (allowing diagonals).

endchoice

config PRG32_PIN_JOYSTICK_X
    int "Joystick X-Axis ADC GPIO"
    depends on PRG32_JOYSTICK_ANALOG
    default -1
    help
        GPIO connected to joystick horizontal (X) axis potentiometer (e.g. GPIO0).

config PRG32_PIN_JOYSTICK_Y
    int "Joystick Y-Axis ADC GPIO"
    depends on PRG32_JOYSTICK_ANALOG
    default -1
    help
        GPIO connected to joystick vertical (Y) axis potentiometer (e.g. GPIO1).

config PRG32_JOYSTICK_DIRECTION_THRESHOLD
    int "Analog Joystick Direction Threshold (8-120)"
    depends on PRG32_JOYSTICK_ANALOG
    range 8 120
    default 40
    help
        Tilt, in the -127..127 units of the calibrated axes, at which LEFT,
        RIGHT, UP, or DOWN turns on. A direction turns off again below three
        fifths of this value (24 for the default 40), so a stick held near the
        threshold does not flicker and repeat menu moves.

config PRG32_JOYSTICK_INVERT_X
    bool "Invert Analog Joystick X-Axis"
    depends on PRG32_JOYSTICK_ANALOG
    default n
    help
        Swap LEFT and RIGHT, for a stick mounted so that a higher ADC reading
        means left.

config PRG32_JOYSTICK_INVERT_Y
    bool "Invert Analog Joystick Y-Axis"
    depends on PRG32_JOYSTICK_ANALOG
    default n
    help
        Swap UP and DOWN, for a stick mounted so that a higher ADC reading
        means up.

config PRG32_JOYSTICK_AXIS_DEADZONE
    int "Analog Joystick Axis Deadzone (0-100)"
    depends on PRG32_JOYSTICK_ANALOG
    range 0 100
    default 12
    help
        Deadzone of prg32_input_axis_x() and prg32_input_axis_y(), in the same
        -127..127 units they return. Positions closer than this to the rest
        point read as 0, so a released stick does not drift. The remaining
        travel is rescaled, so full tilt still reads +/-127.

config PRG32_PIN_BTN_UP
    int "Joystick UP GPIO"
    depends on PRG32_JOYSTICK_DIGITAL
    default -1

config PRG32_PIN_BTN_DOWN
    int "Joystick DOWN GPIO"
    depends on PRG32_JOYSTICK_DIGITAL
    default -1

config PRG32_PIN_BTN_LEFT
    int "Joystick LEFT GPIO"
    depends on PRG32_JOYSTICK_DIGITAL
    default -1

config PRG32_PIN_BTN_RIGHT
    int "Joystick RIGHT GPIO"
    depends on PRG32_JOYSTICK_DIGITAL
    default -1

config PRG32_PIN_BTN_START
    int "START Button GPIO"
    default -1

config PRG32_PIN_BTN_A
    int "A Button GPIO"
    default -1

config PRG32_PIN_BTN_B
    int "B Button GPIO"
    default -1

config PRG32_PIN_BTN_C
    int "C Button GPIO"
    default -1

config PRG32_PIN_BTN_D
    int "D Button GPIO"
    default -1

config PRG32_PIN_BTN_L
    int "L (left bumper) Button GPIO"
    default -1

config PRG32_PIN_BTN_R
    int "R (right bumper) Button GPIO"
    default -1

config PRG32_ENABLE_SEPARATE_SELECT_PIN
    bool "Enable separate SELECT button pin"
    default n

config PRG32_PIN_BTN_SELECT
    int "SELECT Button GPIO"
    depends on PRG32_ENABLE_SEPARATE_SELECT_PIN
    default -1

config PRG32_PIN_SETUP
    int "Dedicated SETUP Button GPIO"
    default -1

config PRG32_PIN_BUZZER
    int "Buzzer GPIO"
    default -1

config PRG32_AUDIO_I2S_BCLK_GPIO
    int "I2S BCLK GPIO"
    depends on PRG32_AUDIO_ENABLED
    default -1

config PRG32_AUDIO_I2S_LRCLK_GPIO
    int "I2S LRCLK/WS GPIO"
    depends on PRG32_AUDIO_ENABLED
    default -1

config PRG32_AUDIO_I2S_DATA_GPIO
    int "I2S DATA/DIN GPIO"
    depends on PRG32_AUDIO_ENABLED
    default -1

config PRG32_AUDIO_I2S_SD_GPIO
    int "I2S SD/shutdown GPIO"
    depends on PRG32_AUDIO_ENABLED
    default -1
    help
        Optional amplifier shutdown/control GPIO. Set to -1 when not wired.

config PRG32_PIN_RGB_LED
    int "RGB LED GPIO"
    default -1

config PRG32_PIN_SHARED_RGB_LED
    int "Boot-only RGB LED GPIO shared with LCD D/C"
    default -1
    help
        Set this only when the onboard addressable LED and LCD D/C are
        electrically tied to one GPIO, as in the breadboard1 and pcb1 profiles
        where the ESP32-C6-DevKitC-1 WS2812 and LCD D/C both use GPIO8. The
        firmware
        flashes it at boot and sends an off frame after LCD updates. LCD
        traffic can still cause brief incidental colors on shared hardware.
        Keep PRG32_PIN_RGB_LED at -1 for the same pin.

config PRG32_QEMU_UART_1_TX
    int "QEMU UART 1 TX (Python Listener)"
    default 4

config PRG32_QEMU_UART_1_RX
    int "QEMU UART 1 RX (Python Listener)"
    default 5

config PRG32_LCD_SPI_CLOCK_HZ
    int "LCD SPI Clock (Hz)"
    default 27000000

config PRG32_LCD_BACKLIGHT_ACTIVE_LEVEL
    int "LCD Backlight Active Level"
    default 1

config PRG32_LCD_BOOT_TEST_MS
    int "LCD Boot Test Delay (ms)"
    default 0

config PRG32_LCD_SOFT_SPI
    int "LCD Soft SPI Mode"
    default 0

config PRG32_BOOT_SIGNAL_ENABLE
    int "Enable Boot Signal"
    default 0

config PRG32_BOOT_DIAGNOSTIC_DELAY_MS
    int "Boot Diagnostic Delay (ms)"
    default 0

endmenu

menu "PRG32 Firmware Features"

choice PRG32_DEFAULT_CONSOLE_MODE
    prompt "Default Console Mode"
    default PRG32_DEFAULT_MODE_UART_LCD_MIRROR

config PRG32_DEFAULT_MODE_UART_ONLY
    bool "UART Only"

config PRG32_DEFAULT_MODE_LCD_ONLY
    bool "LCD Only"

config PRG32_DEFAULT_MODE_UART_LCD_MIRROR
    bool "UART + LCD Mirror"

endchoice

config PRG32_DEBUG
    int "PRG32 Debug Level"
    default 0

config PRG32_GAME_UPLOAD_ENABLE
    bool "Enable Game Upload (SoftAP + HTTP)"
    default n if PRG32_DISPLAY_QEMU_RGB
    default y

config PRG32_WIFI_SCORES_ENABLE
    bool "Enable Wi-Fi Scores API"
    default n

config PRG32_AUDIO_DEFAULT_VOLUME_PCT
    int "Default Audio Volume (%)"
    default 70
    range 0 100

config PRG32_MULTIPLAYER_ENABLE
    bool "Enable Multiplayer Service"
    default y

config PRG32_MULTIPLAYER_SERVER_URL
    string "Multiplayer Server URL"
    depends on PRG32_MULTIPLAYER_ENABLE
    default "ws://192.168.4.2:8081"

config PRG32_BOOT_SETUP_MODE
    int "Boot Setup Mode"
    default 1
    help
        If enabled, at boot the firmware will always go directly to the setup mode. Otherwise, if a cartridge is stored, the first one will be loaded directly.

config PRG32_ENABLE_BOOT_SETUP_COMBO
    bool "Enable A+B Setup Shortcut"
    default n
    help
        If enabled, holding A + B at boot will force PRG32 to enter the setup
        mode instead of loading the default cartridge.

config PRG32_WIFI_AP_CHANNEL
    int "Wi-Fi AP Channel"
    default 6

config PRG32_WIFI_AP_MAX_CONN
    int "Wi-Fi AP Max Connections"
    default 4

config PRG32_WIFI_COUNTRY_CODE
    string "Wi-Fi Country Code"
    default "IT"

config PRG32_WIFI_STA_LEGACY_PROTOCOLS
    int "Wi-Fi STA Legacy Protocols Enabled"
    default 1

endmenu

endmenu
endmenu
```
